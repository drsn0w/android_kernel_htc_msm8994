## arch/arm64/hotplug/Kconfig
```kconfig
config HIMA_HOTPLUG
        bool "Enable hima-hotplug cpu hotplug driver"
        default n
        help
          Generic cpu hotplugging driver for ARM SOCs		 

config BRICKED_HOTPLUG
        bool "Enable kernel based mpdecision"
        depends on MSM_RUN_QUEUE_STATS
        default n
        help
          This enables kernel based multi core control.
          (up/down hotplug based on load)

config MSM_HOTPLUG
	bool "MSM hotplug driver"
	depends on HOTPLUG_CPU
	default n
	help
	  The MSM hotplug driver controls on-/offlining of additional cores based
	  on current cpu load.
```
